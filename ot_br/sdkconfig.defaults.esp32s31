## ot_cli/sdkconfig.defaults.esp32c6
```kconfig
# FLASH
CONFIG_ESPTOOLPY_FLASHMODE_QIO=y
CONFIG_ESPTOOLPY_FLASHFREQ_80M=y

# CPU
CONFIG_ESP_DEFAULT_CPU_FREQ_MHZ_160=y
CONFIG_ESP_DEFAULT_CPU_FREQ_MHZ=160

# Thread
CONFIG_OPENTHREAD_JOINER=y
```
